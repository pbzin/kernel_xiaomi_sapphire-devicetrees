// SPDX-License-Identifier: GPL-2.0-only
/*
 * qcom,mdss_dsi_panel_n7_38_0c_0a_fhdp_video (dsi_n7_38_0c_0a_video)
 *
 * Panel node as shipped on the Redmi Note 13 4G (sapphire) stock dtbo.img
 * (HyperOS OS2.0.215.0.VNHEUXM), reconstructed with labels/references.
 * It already contains the board-level properties (supplies, GPIOs,
 * backlight) that Qualcomm/Xiaomi normally add from the board dtsi.
 */

&mdss_mdp {
	dsi_n7_38_0c_0a_video: qcom,mdss_dsi_panel_n7_38_0c_0a_fhdp_video {
		qcom,platform-reset-gpio = <&tlmm 82 0>;
		qcom,mdss-brightness-max-level = <2047>;
		qcom,mdss-dsi-bl-max-level = <2047>;
		qcom,mdss-dsi-bl-min-level = <1>;
		qcom,mdss-dsi-bl-pmic-control-type = "bl_ctrl_dcs";
		qcom,panel-supply-entries = <&dsi_panel_pwr_supply_no_labibb>;
		qcom,dsi-select-clocks = "pll_byte_clk0", "pll_dsi_clk0";
		qcom,platform-en-gpio = <&pm6125_gpios 9 0>;
		mi,local-hbm-ui-ready-delay-num-frame = <3>;
		mi,doze-lbm-dbv-level = <20>;
		mi,doze-hbm-dbv-level = <252>;
		mi,need-fod-animal-in-normal-enabled;
		mi,mdss-dsi-panel-flatmode-on-status-value = <0>;
		mi,mdss-dsi-panel-flatmode-status-read-length = <1>;
		mi,flatmode-default-on-enabled;
		mi,flatmode-status-check-enabled;
		mi,local-hbm-enabled;
		qcom,mdss-dsi-oled-panel-video-mode;
		qcom,dsi-supported-dfps-list = <120 60>;
		qcom,mdss-dsi-pan-fps-update = "dfps_immediate_porch_mode_vfp";
		qcom,mdss-dsi-pan-enable-dynamic-fps;
		qcom,mdss-dsi-tx-eot-append;
		qcom,esd-err-irq-gpio = <&tlmm 33 8194>;
		qcom,mdss-brightness-init-level = <307>;
		qcom,mdss-pan-physical-height-dimension = <1546>;
		qcom,mdss-pan-physical-width-dimension = <695>;
		qcom,mdss-dsi-reset-sequence = [00 00 00 00 00 00 00 0a 00 00 00 01 00 00 00 0a];
		qcom,mdss-dsi-bl-dcs-type-ss-ea;
		qcom,mdss-dsi-mdp-trigger = "none";
		qcom,mdss-dsi-dma-trigger = "trigger_sw";
		qcom,bl-update-flag = "delay_until_first_frame";
		qcom,mdss-dsi-lane-3-state;
		qcom,mdss-dsi-lane-2-state;
		qcom,mdss-dsi-lane-1-state;
		qcom,mdss-dsi-lane-0-state;
		qcom,mdss-dsi-lp11-init;
		qcom,mdss-dsi-bl-inverted-dbv;
		qcom,mdss-dsi-bllp-power-mode;
		qcom,mdss-dsi-bllp-eof-power-mode;
		qcom,mdss-dsi-traffic-mode = "burst_mode";
		qcom,mdss-dsi-border-color = <0>;
		qcom,mdss-dsi-underflow-color = <255>;
		qcom,mdss-dsi-color-order = "rgb_swap_rgb";
		qcom,mdss-dsi-bpp = <24>;
		qcom,mdss-dsi-stream = <0>;
		qcom,mdss-dsi-virtual-channel-id = <0>;
		qcom,mdss-dsi-panel-type = "dsi_video_mode";
		qcom,dsi-phy-num = <0>;
		qcom,dsi-ctrl-num = <0>;
		qcom,mdss-dsi-panel-id = <0>;
		qcom,mdss-dsi-panel-name = "n7 38 0c 0a video mode fhdp dsi panel";

		qcom,mdss-dsi-display-timings {
			timing@0 {
				qcom,default-topology-index = <0>;
				qcom,display-topology = <1 1 1>;
				qcom,mdss-dsi-panel-phy-timings = [00 22 09 09 19 17 09 09 09 02 04 00 1d 0e];
				qcom,mdss-dsc-block-prediction-enable;
				qcom,mdss-dsc-bit-per-pixel = <8>;
				qcom,mdss-dsc-bit-per-component = <8>;
				qcom,mdss-dsc-slice-per-pkt = <2>;
				qcom,mdss-dsc-slice-width = <540>;
				qcom,mdss-dsc-slice-height = <20>;
				qcom,mdss-dsc-scr-version = <0>;
				qcom,mdss-dsc-version = <17>;
				qcom,compression-mode = "dsc";
				mi,mdss-dsi-local-hbm-off-to-llpm-command-state = [64 73 69 5f 68 73 5f 6d 6f 64 65 00];
				mi,mdss-dsi-local-hbm-off-to-hlpm-command-state = [64 73 69 5f 68 73 5f 6d 6f 64 65 00];
				mi,mdss-dsi-local-hbm-110nit-off-to-normal-command-state = [64 73 69 5f 68 73 5f 6d 6f 64 65 00];
				mi,mdss-dsi-local-hbm-off-to-normal-command-state = [64 73 69 5f 68 73 5f 6d 6f 64 65 00];
				mi,mdss-dsi-local-hbm-off-to-hbm-command-state = [64 73 69 5f 68 73 5f 6d 6f 64 65 00];
				mi,mdss-dsi-local-hbm-normal-green-500nit-command-state = [64 73 69 5f 68 73 5f 6d 6f 64 65 00];
				mi,mdss-dsi-local-hbm-hlpm-white-110nit-command-state = [64 73 69 5f 68 73 5f 6d 6f 64 65 00];
				mi,mdss-dsi-local-hbm-normal-white-110nit-command-state = [64 73 69 5f 68 73 5f 6d 6f 64 65 00];
				mi,mdss-dsi-local-hbm-hlpm-white-1000nit-command-state = [64 73 69 5f 68 73 5f 6d 6f 64 65 00];
				mi,mdss-dsi-local-hbm-normal-white-1000nit-command-state = [64 73 69 5f 68 73 5f 6d 6f 64 65 00];
				mi,mdss-dsi-dispparam-dimming-hbmoff-command-state = [64 73 69 5f 68 73 5f 6d 6f 64 65 00];
				mi,mdss-dsi-dispparam-dimming-hbmon-command-state = [64 73 69 5f 68 73 5f 6d 6f 64 65 00];
				mi,mdss-dsi-flat-mode-off-command-state = [64 73 69 5f 68 73 5f 6d 6f 64 65 00];
				mi,mdss-dsi-flat-mode-on-command-state = [64 73 69 5f 68 73 5f 6d 6f 64 65 00];
				mi,mdss-dsi-doze-lbm-command-state = [64 73 69 5f 68 73 5f 6d 6f 64 65 00];
				mi,mdss-dsi-doze-hbm-command-state = [64 73 69 5f 68 73 5f 6d 6f 64 65 00];
				mi,mdss-dsi-hbm-off-command-state = [64 73 69 5f 6c 70 5f 6d 6f 64 65 00];
				mi,mdss-dsi-hbm-on-command-state = [64 73 69 5f 6c 70 5f 6d 6f 64 65 00];
				qcom,mdss-dsi-dispparam-fps-60hz-command-state = [64 73 69 5f 68 73 5f 6d 6f 64 65 00];
				qcom,mdss-dsi-dispparam-fps-90hz-command-state = [64 73 69 5f 68 73 5f 6d 6f 64 65 00];
				qcom,mdss-dsi-dispparam-fps-120hz-command-state = [64 73 69 5f 68 73 5f 6d 6f 64 65 00];
				qcom,mdss-dsi-pre-off-command-state = [64 73 69 5f 68 73 5f 6d 6f 64 65 00];
				qcom,mdss-dsi-on-command-state = [64 73 69 5f 6c 70 5f 6d 6f 64 65 00];
				mi,mdss-dsi-local-hbm-off-to-llpm-command = [39 00 00 40 00 00 03 f0 5a 5a 39 00 00 40 00 00 02 53 28 39 00 00 40 00 00 04 b0 01 17 b2 39 00 00 40 00 00 02 b2 00 39 00 00 40 00 00 04 b0 00 19 f4 39 00 00 40 00 00 02 f4 0a 39 00 00 40 00 00 04 b0 01 53 b2 39 00 00 40 00 00 0f b2 01 c2 00 40 14 02 80 52 0a 41 48 7f ff ff 39 00 00 40 00 00 04 b0 00 b5 b4 39 00 00 40 00 00 04 b4 00 00 14 39 00 00 40 00 00 04 b0 00 69 b2 39 00 00 40 00 00 08 b2 03 03 03 03 02 01 00 39 00 00 40 00 00 04 b0 00 19 b2 39 00 00 40 00 00 0c b2 0a 41 48 1c 24 28 56 f6 b7 7f f8 39 00 00 00 00 00 02 f7 0b];
				mi,mdss-dsi-local-hbm-off-to-hlpm-command = [39 00 00 40 00 00 03 f0 5a 5a 39 00 00 40 00 00 02 53 28 39 00 00 40 00 00 04 b0 01 17 b2 39 00 00 40 00 00 02 b2 00 39 00 00 40 00 00 04 b0 00 19 f4 39 00 00 40 00 00 02 f4 0a 39 00 00 40 00 00 04 b0 01 53 b2 39 00 00 40 00 00 0f b2 01 c2 00 40 14 02 80 52 0a 41 48 7f ff ff 39 00 00 40 00 00 04 b0 00 b5 b4 39 00 00 40 00 00 04 b4 00 00 14 39 00 00 40 00 00 04 b0 00 69 b2 39 00 00 40 00 00 08 b2 03 03 03 03 02 01 00 39 00 00 40 00 00 04 b0 00 19 b2 39 00 00 40 00 00 0c b2 0a 41 48 1c 24 28 56 f6 b7 7f f8 39 00 00 00 00 00 02 f7 0b];
				mi,mdss-dsi-local-hbm-110nit-off-to-normal-command = [39 00 00 40 00 00 03 f0 5a 5a 39 00 00 40 00 00 02 53 28 39 00 00 40 00 00 04 b0 01 17 b2 39 00 00 40 00 00 02 b2 00 39 00 00 40 00 00 04 b0 00 19 f4 39 00 00 40 00 00 02 f4 0a 39 00 00 40 00 00 04 b0 01 53 b2 39 00 00 40 00 00 0f b2 01 c2 00 40 14 02 80 52 0a 41 48 7f ff ff 39 00 00 40 00 00 04 b0 00 b5 b4 39 00 00 40 00 00 04 b4 00 00 14 39 00 00 40 00 00 04 b0 00 69 b2 39 00 00 40 00 00 08 b2 03 03 03 03 02 01 00 39 00 00 40 00 00 04 b0 00 19 b2 39 00 00 40 00 00 0c b2 0a 41 48 1c 24 28 56 f6 b7 7f f8 39 00 00 00 00 00 02 f7 0b];
				mi,mdss-dsi-local-hbm-off-to-hbm-command = [39 00 00 40 00 00 03 f0 5a 5a 39 00 00 40 00 00 02 53 28 39 00 00 40 00 00 04 b0 01 17 b2 39 00 00 40 00 00 02 b2 00 39 00 00 40 00 00 04 b0 00 19 f4 39 00 00 40 00 00 02 f4 0a 39 00 00 40 00 00 04 b0 01 53 b2 39 00 00 40 00 00 0f b2 01 c2 00 40 14 02 80 52 0a 41 48 7f ff ff 39 00 00 40 00 00 04 b0 00 b5 b4 39 00 00 40 00 00 04 b4 00 00 14 39 00 00 00 00 00 02 f7 0b];
				mi,mdss-dsi-local-hbm-off-to-normal-command = [39 00 00 40 00 00 03 f0 5a 5a 39 00 00 40 00 00 02 53 28 39 00 00 40 00 00 04 b0 01 17 b2 39 00 00 40 00 00 02 b2 00 39 00 00 40 00 00 04 b0 00 19 f4 39 00 00 40 00 00 02 f4 0a 39 00 00 40 00 00 04 b0 01 53 b2 39 00 00 40 00 00 0f b2 01 c2 00 40 14 02 80 52 0a 41 48 7f ff ff 39 00 00 40 00 00 04 b0 00 b5 b4 39 00 00 40 00 00 04 b4 00 00 14 39 00 00 00 00 00 02 f7 0b];
				mi,mdss-dsi-local-hbm-normal-green-500nit-command = [39 00 00 40 00 00 03 f0 5a 5a 39 00 00 40 00 00 02 60 01 39 00 00 40 00 00 02 53 24 39 00 00 40 00 00 04 b0 01 53 b2 39 00 00 40 00 00 0f b2 00 04 7f f7 ff 7f f7 ff 7f f7 ff 7f ff ff 39 00 00 40 00 00 04 b0 00 b5 b4 39 00 00 40 00 00 04 b4 01 00 14 39 00 00 40 00 00 04 b0 01 08 b5 39 00 00 40 00 00 10 b5 02 33 ff 00 ff 1b 87 d9 28 08 a1 21 c8 3d 5d 39 00 00 40 00 00 04 b0 01 4e b2 39 00 00 40 00 00 06 b2 03 33 00 01 00 39 00 00 40 00 00 04 b0 00 19 f4 39 00 00 40 00 00 02 f4 1c 39 00 00 40 00 00 04 b0 01 17 b2 39 00 00 40 00 00 02 b2 01 39 00 00 40 00 00 04 b0 00 bd b4 39 00 00 40 00 00 03 b4 03 ff 39 00 00 40 00 00 04 b0 00 36 b4 39 00 00 40 00 00 0d b4 00 40 14 02 80 52 0a 41 48 7f ff ff 39 00 00 00 00 00 02 f7 0b];
				mi,mdss-dsi-local-hbm-hlpm-white-110nit-command = [39 00 00 40 00 00 03 f0 5a 5a 39 00 00 40 00 00 02 60 01 39 00 00 40 00 00 02 53 24 39 00 00 40 00 00 04 b0 01 53 b2 39 00 00 40 00 00 0f b2 00 04 7f f7 ff 7f f7 ff 7f f7 ff 7f ff ff 39 00 00 40 00 00 04 b0 00 b5 b4 39 00 00 40 00 00 04 b4 01 00 14 39 00 00 40 00 00 04 b0 01 08 b5 39 00 00 40 00 00 10 b5 02 00 00 00 00 1b 87 d9 28 08 a1 21 c8 3d 5d 39 00 00 40 00 00 04 b0 00 19 f4 39 00 00 40 00 00 02 f4 1f 39 00 00 40 00 00 04 b0 01 17 b2 39 00 00 40 00 00 33 b2 01 00 00 00 00 00 01 f0 f0 39 00 00 00 00 15 1d 12 61 15 38 24 7d 15 82 5e c8 16 b9 8c 00 16 f1 c0 3e 2a 52 16 a3 2b d1 87 2c 3b 27 d4 8d 3f 7a 1d e9 39 00 00 40 00 00 04 b0 00 69 b2 39 00 00 40 00 00 08 b2 03 03 03 03 03 02 01 39 00 00 40 00 00 04 b0 00 19 b2 39 00 00 40 00 00 0c b2 0e 41 d4 28 34 92 5f 17 c4 7f f8 39 00 00 40 00 00 04 b0 00 bd b4 39 00 00 40 00 00 03 b4 03 ff 39 00 00 40 00 00 04 b0 01 4e b2 39 00 00 40 00 00 06 b2 03 33 5f 00 bf 39 00 00 40 00 00 04 b0 00 36 b4 39 00 00 40 00 00 0d b4 00 40 14 02 80 52 0a 41 48 7f ff ff 39 00 00 00 00 00 02 f7 0b];
				mi,mdss-dsi-local-hbm-normal-white-110nit-command = [39 00 00 40 00 00 03 f0 5a 5a 39 00 00 40 00 00 02 60 01 39 00 00 40 00 00 02 53 24 39 00 00 40 00 00 04 b0 01 53 b2 39 00 00 40 00 00 0f b2 00 04 7f f7 ff 7f f7 ff 7f f7 ff 7f ff ff 39 00 00 40 00 00 04 b0 00 b5 b4 39 00 00 40 00 00 04 b4 01 00 14 39 00 00 40 00 00 04 b0 01 08 b5 39 00 00 40 00 00 10 b5 02 00 00 00 00 1b 87 d9 28 08 a1 21 c8 3d 5d 39 00 00 40 00 00 04 b0 00 19 f4 39 00 00 40 00 00 02 f4 1f 39 00 00 40 00 00 04 b0 01 17 b2 39 00 00 40 00 00 33 b2 01 00 00 00 00 00 01 f0 f0 39 00 00 00 00 15 1d 12 61 15 38 24 7d 15 82 5e c8 16 b9 8c 00 16 f1 c0 3e 2a 52 16 a3 2b d1 87 2c 3b 27 d4 8d 3f 7a 1d e9 39 00 00 40 00 00 04 b0 00 69 b2 39 00 00 40 00 00 08 b2 03 03 03 03 03 02 01 39 00 00 40 00 00 04 b0 00 19 b2 39 00 00 40 00 00 0c b2 0e 41 d4 28 34 92 5f 17 c4 7f f8 39 00 00 40 00 00 04 b0 00 bd b4 39 00 00 40 00 00 03 b4 03 ff 39 00 00 40 00 00 04 b0 01 4e b2 39 00 00 40 00 00 06 b2 03 33 5f 00 bf 39 00 00 40 00 00 04 b0 00 36 b4 39 00 00 40 00 00 0d b4 00 40 14 02 80 52 0a 41 48 7f ff ff 39 00 00 00 00 00 02 f7 0b];
				mi,mdss-dsi-local-hbm-hlpm-white-1000nit-command = [39 00 00 40 00 00 03 f0 5a 5a 39 00 00 40 00 00 02 60 01 39 00 00 40 00 00 02 53 24 39 00 00 40 00 00 04 b0 01 53 b2 39 00 00 40 00 00 0f b2 00 04 7f f7 ff 7f f7 ff 7f f7 ff 7f ff ff 39 00 00 40 00 00 04 b0 00 b5 b4 39 00 00 40 00 00 04 b4 01 00 14 39 00 00 40 00 00 04 b0 01 08 b5 39 00 00 40 00 00 10 b5 02 00 00 00 00 1b 87 d9 28 08 a1 21 c8 3d 5d 39 00 00 40 00 00 04 b0 01 4e b2 39 00 00 40 00 00 06 b2 03 33 af 3f ff 39 00 00 40 00 00 04 b0 00 19 f4 39 00 00 40 00 00 02 f4 1c 39 00 00 40 00 00 04 b0 01 17 b2 39 00 00 40 00 00 02 b2 01 39 00 00 40 00 00 04 b0 00 bd b4 39 00 00 40 00 00 03 b4 03 ff 39 00 00 40 00 00 04 b0 00 36 b4 39 00 00 40 00 00 0d b4 00 40 14 02 80 52 0a 41 48 7f ff ff 39 00 00 00 00 00 02 f7 0b];
				mi,mdss-dsi-local-hbm-normal-white-1000nit-command = [39 00 00 40 00 00 03 f0 5a 5a 39 00 00 40 00 00 02 60 01 39 00 00 40 00 00 02 53 24 39 00 00 40 00 00 04 b0 01 53 b2 39 00 00 40 00 00 0f b2 00 04 7f f7 ff 7f f7 ff 7f f7 ff 7f ff ff 39 00 00 40 00 00 04 b0 00 b5 b4 39 00 00 40 00 00 04 b4 01 00 14 39 00 00 40 00 00 04 b0 01 08 b5 39 00 00 40 00 00 10 b5 02 00 00 00 00 1b 87 d9 28 08 a1 21 c8 3d 5d 39 00 00 40 00 00 04 b0 01 4e b2 39 00 00 40 00 00 06 b2 03 33 af 3f ff 39 00 00 40 00 00 04 b0 00 19 f4 39 00 00 40 00 00 02 f4 1c 39 00 00 40 00 00 04 b0 01 17 b2 39 00 00 40 00 00 02 b2 01 39 00 00 40 00 00 04 b0 00 bd b4 39 00 00 40 00 00 03 b4 03 ff 39 00 00 40 00 00 04 b0 00 36 b4 39 00 00 40 00 00 0d b4 00 40 14 02 80 52 0a 41 48 7f ff ff 39 00 00 00 00 00 02 f7 0b];
				mi,mdss-dsi-flat-mode-off-command = [39 01 00 40 00 00 03 f0 5a 5a 39 01 00 40 00 00 04 b0 00 89 b1 39 01 00 40 00 00 02 b1 0d 39 01 00 40 00 00 04 b0 00 8e b1 39 01 00 40 00 00 02 b1 0f 39 01 00 00 00 00 03 f0 a5 a5];
				mi,mdss-dsi-flat-mode-on-command = [39 01 00 40 00 00 03 f0 5a 5a 39 01 00 40 00 00 04 b0 00 89 b1 39 01 00 40 00 00 02 b1 2d 39 01 00 40 00 00 04 b0 00 8e b1 39 01 00 40 00 00 02 b1 0f 39 01 00 00 00 00 03 f0 a5 a5];
				mi,mdss-dsi-doze-lbm-command = [39 01 00 00 00 00 03 51 00 18];
				mi,mdss-dsi-doze-hbm-command = [39 01 00 00 00 00 03 51 01 1b];
				mi,mdss-dsi-dispparam-dimming-hbmoff-command = [39 01 00 00 00 00 03 f0 5a 5a 39 01 00 00 00 00 04 b0 00 0d b2 39 01 00 00 00 00 02 b2 05 39 01 00 00 00 00 04 b0 00 0c b2 39 01 00 00 00 00 02 b2 30 39 01 00 00 00 00 02 f7 0b 39 01 00 00 00 00 03 f0 a5 a5];
				mi,mdss-dsi-dispparam-dimming-hbmon-command = [39 01 00 00 00 00 03 f0 5a 5a 39 01 00 00 00 00 04 b0 00 0d b2 39 01 00 00 00 00 02 b2 30 39 01 00 00 00 00 04 b0 00 0c b2 39 01 00 00 00 00 02 b2 30 39 01 00 00 00 00 02 f7 0b 39 01 00 00 00 00 03 f0 a5 a5];
				mi,mdss-dsi-hbm-off-command = [39 00 00 40 00 00 02 53 28 39 00 00 00 00 00 03 51 07 ff];
				qcom,mdss-dsi-dispparam-hbm-on-l5-command-state = [64 73 69 5f 6c 70 5f 6d 6f 64 65 00];
				qcom,mdss-dsi-dispparam-hbm-on-l5-command = [39 00 00 40 00 00 02 53 e8 39 00 00 40 00 00 03 51 07 ff 39 00 00 00 00 00 02 f7 0b];
				qcom,mdss-dsi-dispparam-hbm-on-l4-command-state = [64 73 69 5f 6c 70 5f 6d 6f 64 65 00];
				qcom,mdss-dsi-dispparam-hbm-on-l4-command = [39 00 00 40 00 00 02 53 e8 39 00 00 40 00 00 03 51 05 b6 39 00 00 00 00 00 02 f7 0b];
				qcom,mdss-dsi-dispparam-hbm-on-l3-command-state = [64 73 69 5f 6c 70 5f 6d 6f 64 65 00];
				qcom,mdss-dsi-dispparam-hbm-on-l3-command = [39 00 00 40 00 00 02 53 e8 39 00 00 40 00 00 03 51 03 6e 39 00 00 00 00 00 02 f7 0b];
				qcom,mdss-dsi-dispparam-hbm-on-l2-command-state = [64 73 69 5f 6c 70 5f 6d 6f 64 65 00];
				qcom,mdss-dsi-dispparam-hbm-on-l2-command = [39 00 00 40 00 00 02 53 e8 39 00 00 40 00 00 03 51 02 26 39 00 00 00 00 00 02 f7 0b];
				qcom,mdss-dsi-dispparam-hbm-on-l1-command-state = [64 73 69 5f 6c 70 5f 6d 6f 64 65 00];
				qcom,mdss-dsi-dispparam-hbm-on-l1-command = [39 00 00 40 00 00 02 53 e8 39 00 00 40 00 00 03 51 01 25 39 00 00 00 00 00 02 f7 0b];
				mi,mdss-dsi-hbm-on-command = [39 00 00 40 00 00 02 53 e8 39 00 00 40 00 00 03 51 07 ff 39 00 00 00 00 00 02 f7 0b];
				qcom,mdss-dsi-dispparam-fps-60hz-command = [39 00 00 40 00 00 03 f0 5a 5a 39 00 00 40 00 00 02 60 21 39 00 00 00 00 00 02 f7 0b];
				qcom,mdss-dsi-dispparam-fps-90hz-command = [39 00 00 40 00 00 03 f0 5a 5a 39 00 00 40 00 00 03 f1 5a 5a 39 00 00 40 00 00 02 60 01 39 00 00 40 00 00 04 b0 00 0b f2 39 00 00 40 00 00 03 f2 03 44 39 00 00 40 00 00 04 b0 01 9e b2 39 00 00 40 00 00 0f b2 0c b0 0c 60 0c 20 0b 91 0b 02 0a 65 09 47 39 00 00 40 00 00 13 b3 08 1a 06 fc 05 cf 04 b1 03 84 01 d7 00 1c 00 1c 00 1c 39 00 00 40 00 00 02 f7 0b 39 00 00 40 00 00 03 f1 a5 a5 39 00 00 00 00 00 03 f0 a5 a5];
				qcom,mdss-dsi-dispparam-fps-120hz-command = [39 00 00 40 00 00 03 f0 5a 5a 39 00 00 40 00 00 02 60 01 39 00 00 00 00 00 02 f7 0b];
				qcom,mdss-dsi-pre-off-command = [05 01 00 00 14 00 02 28 00 05 01 00 00 96 00 02 10 00];
				qcom,mdss-dsi-on-command = [05 01 00 00 20 00 02 11 00 39 01 00 00 00 00 03 f0 5a 5a 39 01 00 00 00 00 03 b2 01 31 39 01 00 00 00 00 08 df 09 30 95 43 a9 43 a9 39 01 00 00 00 00 03 f0 a5 a5 39 01 00 00 00 00 02 9d 01 39 01 00 00 00 00 5a 9e 11 00 00 89 30 80 09 60 04 38 00 28 02 1c 02 1c 02 00 02 0e 00 20 03 dd 00 07 00 0c 02 77 02 8b 18 00 10 f0 03 0c 20 00 06 0b 0b 33 0e 1c 2a 38 46 54 62 69 70 77 79 7b 7d 7e 01 02 01 00 09 40 09 be 19 fc 19 fa 19 f8 1a 38 1a 78 1a b6 2a f6 2b 34 2b 74 3b 74 6b f4 00 39 01 00 00 00 00 03 f0 5a 5a 39 01 00 00 00 00 02 60 01 39 01 00 00 00 00 02 f7 0b 39 01 00 00 00 00 03 f0 a5 a5 39 01 00 00 00 00 03 f0 5a 5a 39 01 00 00 00 00 04 b0 00 40 f2 39 01 00 00 00 00 02 f2 03 39 01 00 00 00 00 03 f0 a5 a5 39 01 00 00 00 00 03 fc 5a 5a 39 00 00 00 00 00 04 b0 00 11 fe 39 00 00 00 00 00 02 fe 00 39 01 00 00 00 00 03 fc a5 a5 39 01 00 00 00 00 04 b0 00 0d b2 39 01 00 00 00 00 02 b2 08 39 01 00 00 00 00 04 b0 00 0c b2 39 01 00 00 00 00 02 b2 20 39 01 00 00 00 00 02 f7 0b 39 01 00 00 00 00 03 f0 a5 a5 39 01 00 00 00 00 03 f0 5a 5a 39 01 00 00 00 00 03 fc 5a 5a 39 01 00 00 00 00 04 ed 01 cd 00 39 01 00 00 00 00 02 e1 93 39 01 00 00 00 00 04 b0 00 06 f4 39 01 00 00 00 00 02 f4 1f 39 01 00 00 00 00 03 f0 a5 a5 39 01 00 00 00 00 03 fc a5 a5 39 01 00 00 00 00 02 53 28 39 01 00 00 64 00 03 51 00 00 05 01 00 00 00 00 02 29 00];
				qcom,mdss-dsi-panel-framerate = <120>;
				qcom,mdss-dsi-v-pulse-width = <2>;
				qcom,mdss-dsi-v-front-porch = <20>;
				qcom,mdss-dsi-v-back-porch = <10>;
				qcom,mdss-dsi-h-sync-skew = <0>;
				qcom,mdss-dsi-h-pulse-width = <16>;
				qcom,mdss-dsi-h-back-porch = <24>;
				qcom,mdss-dsi-h-front-porch = <180>;
				qcom,mdss-dsi-panel-height = <2400>;
				qcom,mdss-dsi-panel-width = <1080>;
				qcom,mdss-dsi-video-mode;
			};
		};
	};
};
