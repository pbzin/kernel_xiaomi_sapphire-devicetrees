// SPDX-License-Identifier: GPL-2.0-only
/*
 * qcom,mdss_dsi_panel_m7_38_0c_0b_fhdp_video (dsi_m7_38_0c_0b_video)
 *
 * Panel node as shipped on the Redmi Note 13 4G (sapphire) stock dtbo.img
 * (HyperOS OS2.0.215.0.VNHEUXM), reconstructed with labels/references.
 * It already contains the board-level properties (supplies, GPIOs,
 * backlight) that Qualcomm/Xiaomi normally add from the board dtsi.
 */

&mdss_mdp {
	dsi_m7_38_0c_0b_video: qcom,mdss_dsi_panel_m7_38_0c_0b_fhdp_video {
		qcom,platform-reset-gpio = <&tlmm 82 0>;
		qcom,mdss-brightness-max-level = <2047>;
		qcom,mdss-dsi-bl-max-level = <2047>;
		qcom,mdss-dsi-bl-min-level = <1>;
		qcom,mdss-dsi-bl-pmic-control-type = "bl_ctrl_dcs";
		qcom,panel-supply-entries = <&dsi_panel_pwr_supply_no_labibb>;
		qcom,dsi-select-clocks = "pll_byte_clk0", "pll_dsi_clk0";
		qcom,platform-en-gpio = <&pm6125_gpios 9 0>;
		qcom,mdss-dsi-oled-panel-video-mode;
		qcom,dsi-supported-dfps-list = <120 60>;
		qcom,mdss-dsi-pan-fps-update = "dfps_immediate_porch_mode_vfp";
		qcom,mdss-dsi-pan-enable-dynamic-fps;
		qcom,mdss-dsi-tx-eot-append;
		qcom,esd-err-irq-gpio = <&tlmm 33 8194>;
		qcom,mdss-brightness-init-level = <307>;
		qcom,mdss-pan-physical-height-dimension = <1546>;
		qcom,mdss-pan-physical-width-dimension = <695>;
		qcom,mdss-dsi-reset-sequence = [00 00 00 00 00 00 00 0a 00 00 00 01 00 00 00 0a];
		qcom,mdss-dsi-bl-dcs-type-ss-ea;
		qcom,mdss-dsi-mdp-trigger = "none";
		qcom,mdss-dsi-dma-trigger = "trigger_sw";
		qcom,bl-update-flag = "delay_until_first_frame";
		qcom,mdss-dsi-lane-3-state;
		qcom,mdss-dsi-lane-2-state;
		qcom,mdss-dsi-lane-1-state;
		qcom,mdss-dsi-lane-0-state;
		qcom,mdss-dsi-lp11-init;
		qcom,mdss-dsi-bl-inverted-dbv;
		qcom,mdss-dsi-bllp-power-mode;
		qcom,mdss-dsi-bllp-eof-power-mode;
		qcom,mdss-dsi-traffic-mode = "burst_mode";
		qcom,mdss-dsi-border-color = <0>;
		qcom,mdss-dsi-underflow-color = <255>;
		qcom,mdss-dsi-color-order = "rgb_swap_rgb";
		qcom,mdss-dsi-bpp = <24>;
		qcom,mdss-dsi-stream = <0>;
		qcom,mdss-dsi-virtual-channel-id = <0>;
		qcom,mdss-dsi-panel-type = "dsi_video_mode";
		qcom,dsi-phy-num = <0>;
		qcom,dsi-ctrl-num = <0>;
		qcom,mdss-dsi-panel-id = <0>;
		qcom,mdss-dsi-panel-name = "m7 38 0c 0b video mode fhdp dsi panel";

		qcom,mdss-dsi-display-timings {
			timing@0 {
				qcom,default-topology-index = <0>;
				qcom,display-topology = <1 1 1>;
				qcom,mdss-dsi-panel-phy-timings = [00 24 0a 0a 1a 19 09 0a 09 02 04 00 1e 0f];
				qcom,mdss-dsc-block-prediction-enable;
				qcom,mdss-dsc-bit-per-pixel = <8>;
				qcom,mdss-dsc-bit-per-component = <8>;
				qcom,mdss-dsc-slice-per-pkt = <2>;
				qcom,mdss-dsc-slice-width = <540>;
				qcom,mdss-dsc-slice-height = <20>;
				qcom,mdss-dsc-scr-version = <0>;
				qcom,mdss-dsc-version = <17>;
				qcom,compression-mode = "dsc";
				mi,mdss-dsi-flat-mode-off-command-state = [64 73 69 5f 68 73 5f 6d 6f 64 65 00];
				mi,mdss-dsi-flat-mode-on-command-state = [64 73 69 5f 68 73 5f 6d 6f 64 65 00];
				mi,mdss-dsi-doze-lbm-command-state = [64 73 69 5f 68 73 5f 6d 6f 64 65 00];
				mi,mdss-dsi-doze-hbm-command-state = [64 73 69 5f 68 73 5f 6d 6f 64 65 00];
				mi,mdss-dsi-hbm-off-command-state = [64 73 69 5f 6c 70 5f 6d 6f 64 65 00];
				mi,mdss-dsi-hbm-on-command-state = [64 73 69 5f 6c 70 5f 6d 6f 64 65 00];
				qcom,mdss-dsi-dispparam-fps-60hz-command-state = [64 73 69 5f 68 73 5f 6d 6f 64 65 00];
				qcom,mdss-dsi-dispparam-fps-90hz-command-state = [64 73 69 5f 68 73 5f 6d 6f 64 65 00];
				qcom,mdss-dsi-dispparam-fps-120hz-command-state = [64 73 69 5f 68 73 5f 6d 6f 64 65 00];
				qcom,mdss-dsi-off-command-state = [64 73 69 5f 68 73 5f 6d 6f 64 65 00];
				qcom,mdss-dsi-on-command-state = [64 73 69 5f 6c 70 5f 6d 6f 64 65 00];
				mi,mdss-dsi-flat-mode-off-command = [39 01 00 40 00 00 03 f1 5a 5a 39 01 00 40 00 00 05 b0 00 88 b1 01 39 01 00 40 00 00 29 b1 27 0d fe 0f 99 80 01 ff 12 8f ff 12 ff 38 39 5b 0b 0b 0b 2e 2e 2e 3e 3e 3e 4a 4a 4a 4e 4e 4e 1b 2f da 18 74 80 00 00 22 39 01 00 00 00 00 03 f1 a5 a5];
				mi,mdss-dsi-flat-mode-on-command = [39 01 00 40 00 00 03 f1 5a 5a 39 01 00 40 00 00 05 b0 00 88 b1 01 39 01 00 40 00 00 29 b1 27 2d c5 0f 61 80 01 ff 12 26 ff 12 ff 42 44 6e 0b 0b 0b 2d 2d 2d 3c 3c 3c 47 47 47 4b 4b 4b 1b 2f da 18 64 80 00 00 22 39 01 00 40 00 00 05 b0 00 03 b8 01 39 01 00 40 00 00 05 b8 ff 8f 01 ff 39 01 00 40 00 00 05 b0 00 f8 b5 01 39 01 00 40 00 00 0f b5 e2 0e 0e 0e 82 1e 95 80 00 00 00 00 ff 90 39 01 00 00 00 00 03 f1 a5 a5];
				mi,mdss-dsi-doze-lbm-command = [39 01 00 00 00 00 03 51 00 18];
				mi,mdss-dsi-doze-hbm-command = [39 01 00 00 00 00 03 51 01 1b];
				mi,mdss-dsi-hbm-off-command = [39 00 00 40 00 00 02 53 30 39 00 00 00 00 00 02 f7 07];
				mi,mdss-dsi-hbm-on-command = [39 00 00 40 00 00 02 53 f0 39 00 00 40 00 00 03 51 07 ff 39 00 00 00 00 00 02 f7 07];
				qcom,mdss-dsi-dispparam-fps-60hz-command = [39 00 00 40 00 00 03 f1 5a 5a 39 00 00 40 00 00 02 60 21 39 00 00 00 00 00 02 f7 07];
				qcom,mdss-dsi-dispparam-fps-90hz-command = [39 00 00 40 00 00 03 f1 5a 5a 39 00 00 40 00 00 02 60 01 39 00 00 00 00 00 02 f7 07];
				qcom,mdss-dsi-dispparam-fps-120hz-command = [39 00 00 40 00 00 03 f1 5a 5a 39 00 00 40 00 00 02 60 01 39 00 00 00 00 00 02 f7 07];
				qcom,mdss-dsi-off-command = [05 01 00 00 0b 00 01 28 05 01 00 00 97 00 01 10];
				qcom,mdss-dsi-on-command = [39 01 00 00 0b 00 03 9f 5a 5a 05 01 00 00 14 00 02 11 00 39 01 00 00 00 00 03 f1 5a 5a 39 01 00 00 00 00 03 b2 01 30 39 01 00 00 00 00 03 f1 a5 a5 39 01 00 00 00 00 02 9d 01 39 01 00 00 00 00 5a 9e 11 00 00 89 30 80 09 60 04 38 00 28 02 1c 02 1c 02 00 02 0e 00 20 03 dd 00 07 00 0c 02 77 02 8b 18 00 10 f0 03 0c 20 00 06 0b 0b 33 0e 1c 2a 38 46 54 62 69 70 77 79 7b 7d 7e 01 02 01 00 09 40 09 be 19 fc 19 fa 19 f8 1a 38 1a 78 1a b6 2a f6 2b 34 2b 74 3b 74 6b f4 00 39 01 00 00 00 00 05 f1 5a 5a 5a 5a 39 01 00 00 00 00 05 b0 00 9d e0 01 39 01 00 00 00 00 02 e0 00 39 01 00 00 00 00 05 f1 a5 a5 a5 a5 39 01 00 00 00 00 03 f1 5a 5a 39 01 00 00 00 00 02 60 01 39 01 00 00 00 00 02 f7 07 39 01 00 00 00 00 03 f1 a5 a5 39 01 00 00 00 00 05 f1 5a 5a 5a 5a 39 01 00 00 00 00 05 b0 00 32 f6 01 39 01 00 00 00 00 06 f6 24 00 19 00 00 39 01 00 00 00 00 05 f1 a5 a5 a5 a5 39 01 00 00 00 00 03 f1 5a 5a 39 01 00 00 00 00 05 b0 00 0d b2 01 39 01 00 00 00 00 02 b2 20 39 01 00 00 00 00 05 b0 00 0c b2 01 39 01 00 00 00 00 02 b2 30 39 01 00 00 00 00 03 f1 a5 a5 39 01 00 00 00 00 05 f1 5a 5a 5a 5a 39 01 00 00 00 00 05 b0 00 0b ce 01 39 01 00 00 00 00 02 ce 11 39 01 00 00 00 00 05 b0 00 08 ea 01 39 01 00 00 00 00 03 ea f6 89 39 01 00 00 00 00 05 b0 00 0a ea 01 39 01 00 00 00 00 04 ea 55 01 04 39 01 00 00 00 00 05 b0 00 0d ea 01 39 01 00 00 00 00 03 ea ff ff 39 01 00 00 00 00 05 b0 00 74 e1 01 39 01 00 00 00 00 02 e1 3f 39 01 00 00 00 00 05 b0 00 10 ea 01 39 01 00 00 00 00 02 ea 01 39 01 00 00 00 00 05 f1 a5 a5 a5 a5 39 01 00 00 00 00 02 53 30 39 01 00 00 00 00 03 51 00 00 39 01 00 00 65 00 02 f7 07 05 01 00 00 00 00 02 29 00];
				qcom,mdss-dsi-panel-framerate = <120>;
				qcom,mdss-dsi-v-pulse-width = <2>;
				qcom,mdss-dsi-v-front-porch = <20>;
				qcom,mdss-dsi-v-back-porch = <10>;
				qcom,mdss-dsi-h-sync-skew = <0>;
				qcom,mdss-dsi-h-pulse-width = <28>;
				qcom,mdss-dsi-h-back-porch = <120>;
				qcom,mdss-dsi-h-front-porch = <120>;
				qcom,mdss-dsi-panel-height = <2400>;
				qcom,mdss-dsi-panel-width = <1080>;
				qcom,mdss-dsi-video-mode;
			};
		};
	};
};
